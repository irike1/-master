/dts-v1/;
#include <nordic/nrf5340_cpuappns_qkaa.dtsi>
#include "new_board-pinctrl.dtsi"

/ {
	model = "new_board (CPUAPP Non-Secure)";
	compatible = "non,new-board-cpuapp-ns";

	chosen {
		zephyr,sram = &sram0_ns;
		zephyr,flash = &flash0;
		zephyr,code-partition = &slot0_ns_partition;
	};
};

#include "new_board-cpuapp_partitioning.dtsi"
#include "new_board-shared_sram.dtsi"
