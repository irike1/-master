## boards/boards/Shadow-Garden/Alpha/board.yml
```yaml
board:
  name: Alpha
  vendor: Shadow-Garden
  socs:
  - name: nrf5340
    variants:
    - name: ns
      cpucluster: cpuapp
```

## boards/new/boards/non/new_board/board.yml
```yaml
board:
  name: new_board
  vendor: non
  socs:
  - name: nrf5340
    variants:
    - name: ns
      cpucluster: cpuapp
```

## build/Kconfig/boards/Kconfig
```kconfig
# Load Zephyr board Kconfig descriptions.
osource "C:/my_boards/boards/nordic/g915/Kconfig"
```

## build/Kconfig/boards/Kconfig.sysbuild
```kconfig
# Load Sysbuild board Kconfig descriptions.
osource "C:/my_boards/boards/nordic/g915/Kconfig.sysbuild"
```

## build_1/Kconfig/boards/Kconfig.g915
```kconfig
# Load board Kconfig descriptions.
osource "C:/my_boards/boards/nordic/g915/Kconfig.g915"
```

## build_1/master/Kconfig/Kconfig.shield
```kconfig
osource "C:/my_boards/boards/shields/*/Kconfig.shield"
osource "C:/ncs/v3.1.0/nrf/boards/shields/*/Kconfig.shield"
```

## build_1/master/Kconfig/boards/Kconfig.defconfig
```kconfig
# Load Zephyr board defconfig descriptions.
osource "C:/my_boards/boards/nordic/g915/Kconfig.defconfig"
```

## build_2/Kconfig/Kconfig.shield.defconfig
```kconfig
osource "C:/my_boards/boards/shields/*/Kconfig.defconfig"
osource "C:/ncs/v3.1.0/nrf/boards/shields/*/Kconfig.defconfig"
```
